## layers/meta-balena-imx8m-var-dart/conf/machine/imx8m-var-dart.conf
```bitbake
#@TYPE: Machine
##@NAME: imx8m-var-dart
##@DESCRIPTION: Machine configuration for the imx8m-var-dart
#@NAME: Variscite DART-MX8M
#@SOC: i.MX8MQ
#@DESCRIPTION: Machine configuration for Variscite DART-MX8M
#@MAINTAINER: Nate Drude <nate.d@variscite.com>
#
# http://www.variscite.com

MACHINEOVERRIDES = "imx8mq-var-dart:${MACHINE}"
 
include conf/machine/imx8mq-var-dart.inc
```

## layers/meta-balena-imx8m-var-dart/conf/machine/imx8mm-var-dart-nrt.conf
```bitbake
#@TYPE: Machine
##@NAME: imx8mm-var-dart-nrt
##@DESCRIPTION: Machine configuration for the imx8mm-var-dart-nrt

MACHINEOVERRIDES = "imx8mm-var-dart:${MACHINE}"
include conf/machine/imx8mm-var-dart.conf
```

## layers/meta-balena-imx8m-var-dart/conf/machine/imx8mm-var-dart-plt.conf
```bitbake
#@TYPE: Machine
##@NAME: imx8mm-var-dart-plt
##@DESCRIPTION: Machine configuration for the imx8mm-var-dart-plt

MACHINEOVERRIDES = "imx8mm-var-dart:${MACHINE}"
include conf/machine/imx8mm-var-dart.conf
```

## layers/meta-balena-imx8m-var-dart/conf/machine/imx8mm-var-dart.conf
```bitbake
#@TYPE: Machine
##@NAME: imx8mm-var-dart-nrt
##@DESCRIPTION: Machine configuration for the imx8mm-var-dart-nrt

include conf/machine/imx8mm-var-dart.inc

SERIAL_CONSOLES = "115200;ttymxc0"
```

## layers/meta-balena-imx8m-var-dart/conf/machine/imx8mm-var-dart.inc
```bitbake
MACHINEOVERRIDES =. "mx8mm:"
require conf/machine/include/imx-base.inc
require conf/machine/include/arm/armv8a/tune-cortexa53.inc

require conf/machine/variscite.inc
require conf/machine/variscite_bcm43xx.inc

# Variscite BSP default providers
PREFERRED_PROVIDER_virtual/kernel:imx8mm-var-dart ?= "linux-variscite"
PREFERRED_PROVIDER_u-boot:imx8mm-var-dart ?= "u-boot-variscite"
PREFERRED_PROVIDER_u-boot-fw-utils:imx8mm-var-dart ?= "u-boot-fw-utils"
PREFERRED_PROVIDER_virtual/bootloader:imx8mm-var-dart ?= "u-boot-variscite"

KERNEL_DEVICETREE = " \
	freescale/imx8mm-var-dart-dt8mcustomboard.dtb \
	freescale/imx8mm-var-dart-dt8mcustomboard-legacy.dtb \
	freescale/imx8mm-var-som-symphony.dtb \
	freescale/imx8mm-var-dart-dt8mcustomboard-m4.dtb \
	freescale/imx8mm-var-dart-dt8mcustomboard-legacy-m4.dtb \
	freescale/imx8mm-var-som-symphony-m4.dtb \
"

MACHINE_EXTRA_RRECOMMENDS:remove = " imx-m4-demos"

UBOOT_CONFIG ??= "sd"
UBOOT_CONFIG[sd] = "imx8mm_var_dart_config,sdcard"
SPL_BINARY = "spl/u-boot-spl.bin"

ATF_PLATFORM = "imx8mm"
ATF_LOAD_ADDR = "0x920000"

# Set DDR FIRMWARE
DDR_FIRMWARE_NAME = " \
	ddr4_imem_1d.bin \
	ddr4_dmem_1d.bin \
	ddr4_imem_2d.bin \
	ddr4_dmem_2d.bin \
	lpddr4_pmu_train_1d_imem.bin \
	lpddr4_pmu_train_1d_dmem.bin \
	lpddr4_pmu_train_2d_imem.bin \
	lpddr4_pmu_train_2d_dmem.bin \
"
# Set U-Boot DTB
UBOOT_DTB_NAME = "imx8mm-var-dart-customboard.dtb"
UBOOT_DTB_EXTRA = "imx8mm-var-som-symphony.dtb"

# Set imx-mkimage boot target
IMXBOOT_TARGETS = "flash_lpddr4_ddr4_evk"

IMX_BOOT_SOC_TARGET = "iMX8MM"

# Extra firmware package name, that is required to build boot container for fslc bsp
IMX_EXTRA_FIRMWARE = "firmware-imx-8m"

SERIAL_CONSOLES = "115200;ttymxc0 "

IMAGE_BOOTLOADER = "imx-boot"

LOADADDR = ""
UBOOT_SUFFIX = "bin"
UBOOT_MAKE_TARGET = "all"
IMX_BOOT_SEEK = "33"

# If you change TEE_LOAD_ADDR, make sure to align patch for soc.mak
TEE_LOAD_ADDR ?= "0x56000000"
TEE_CFG_DDR_SIZE ?= "0x80000000"
```

## layers/meta-balena-imx8m-var-dart/conf/machine/imx8mm-var-som.conf
```bitbake
#@TYPE: Machine
##@NAME: imx8mm-var-som
##@DESCRIPTION: Machine configuration for the imx8mm-var-som

MACHINEOVERRIDES = "imx8mm-var-dart:${MACHINE}"
include conf/machine/imx8mm-var-dart.inc

SERIAL_CONSOLES:imx8mm-var-som = "115200;ttymxc3"
```

## layers/meta-balena-imx8m-var-dart/conf/machine/imx8mq-var-dart.inc
```bitbake
#@TYPE: Machine
#@NAME: Variscite DART-MX8M
#@SOC: i.MX8MQ
#@DESCRIPTION: Machine configuration for Variscite DART-MX8M
#@MAINTAINER: Nate Drude <nate.d@variscite.com>
#
# http://www.variscite.com

MACHINEOVERRIDES =. "mx8mq:"
require conf/machine/include/imx-base.inc
require conf/machine/include/arm/armv8a/tune-cortexa53.inc

require variscite.inc
require variscite_bcm43xx.inc

# Variscite BSP default providers
PREFERRED_PROVIDER_virtual/kernel:imx8mq-var-dart ?= "linux-variscite"
PREFERRED_PROVIDER_u-boot:imx8mq-var-dart ?= "u-boot-variscite"
PREFERRED_PROVIDER_u-boot-fw-utils:imx8mq-var-dart ?= "u-boot-fw-utils"
PREFERRED_PROVIDER_virtual/bootloader:imx8mq-var-dart ?= "u-boot-variscite"

KERNEL_DEVICETREE = " \
	freescale/imx8mq-var-dart-dt8mcustomboard-legacy-m4-sd-dp.dtb \
	freescale/imx8mq-var-dart-dt8mcustomboard-legacy-m4-sd-hdmi.dtb \
	freescale/imx8mq-var-dart-dt8mcustomboard-legacy-m4-sd-lvds-dp.dtb \
	freescale/imx8mq-var-dart-dt8mcustomboard-legacy-m4-sd-lvds.dtb \
	freescale/imx8mq-var-dart-dt8mcustomboard-legacy-m4-sd-lvds-hdmi.dtb \
	freescale/imx8mq-var-dart-dt8mcustomboard-legacy-m4-wifi-dp.dtb \
	freescale/imx8mq-var-dart-dt8mcustomboard-legacy-m4-wifi-hdmi.dtb \
	freescale/imx8mq-var-dart-dt8mcustomboard-legacy-m4-wifi-lvds-dp.dtb \
	freescale/imx8mq-var-dart-dt8mcustomboard-legacy-m4-wifi-lvds.dtb \
	freescale/imx8mq-var-dart-dt8mcustomboard-legacy-m4-wifi-lvds-hdmi.dtb \
	freescale/imx8mq-var-dart-dt8mcustomboard-legacy-sd-dp.dtb \
	freescale/imx8mq-var-dart-dt8mcustomboard-legacy-sd-hdmi.dtb \
	freescale/imx8mq-var-dart-dt8mcustomboard-legacy-sd-lvds-dp.dtb \
	freescale/imx8mq-var-dart-dt8mcustomboard-legacy-sd-lvds.dtb \
	freescale/imx8mq-var-dart-dt8mcustomboard-legacy-sd-lvds-hdmi.dtb \
	freescale/imx8mq-var-dart-dt8mcustomboard-legacy-wifi-dp.dtb \
	freescale/imx8mq-var-dart-dt8mcustomboard-legacy-wifi-hdmi.dtb \
	freescale/imx8mq-var-dart-dt8mcustomboard-legacy-wifi-lvds-dp.dtb \
	freescale/imx8mq-var-dart-dt8mcustomboard-legacy-wifi-lvds.dtb \
	freescale/imx8mq-var-dart-dt8mcustomboard-legacy-wifi-lvds-hdmi.dtb \
	freescale/imx8mq-var-dart-dt8mcustomboard-m4-sd-hdmi.dtb \
	freescale/imx8mq-var-dart-dt8mcustomboard-m4-sd-lvds.dtb \
	freescale/imx8mq-var-dart-dt8mcustomboard-m4-sd-lvds-hdmi.dtb \
	freescale/imx8mq-var-dart-dt8mcustomboard-m4-wifi-hdmi.dtb \
	freescale/imx8mq-var-dart-dt8mcustomboard-m4-wifi-lvds.dtb \
	freescale/imx8mq-var-dart-dt8mcustomboard-m4-wifi-lvds-hdmi.dtb \
	freescale/imx8mq-var-dart-dt8mcustomboard-sd-hdmi.dtb \
	freescale/imx8mq-var-dart-dt8mcustomboard-sd-lvds.dtb \
	freescale/imx8mq-var-dart-dt8mcustomboard-sd-lvds-hdmi.dtb \
	freescale/imx8mq-var-dart-dt8mcustomboard-wifi-hdmi.dtb \
	freescale/imx8mq-var-dart-dt8mcustomboard-wifi-lvds.dtb \
	freescale/imx8mq-var-dart-dt8mcustomboard-wifi-lvds-hdmi.dtb \
"

MACHINE_EXTRA_RRECOMMENDS:remove = " imx-m4-demos"

UBOOT_CONFIG ??= "sd"
UBOOT_CONFIG[sd] = "imx8mq_var_dart_config,sdcard"
SPL_BINARY = "spl/u-boot-spl.bin"

ATF_PLATFORM = "imx8mq"

# Set DDR FIRMWARE
DDR_FIRMWARE_NAME = "lpddr4_pmu_train_1d_imem.bin lpddr4_pmu_train_1d_dmem.bin lpddr4_pmu_train_2d_imem.bin lpddr4_pmu_train_2d_dmem.bin"

# Set U-Boot DTB
UBOOT_DTB_NAME = "imx8mq-var-dart-dt8mcustomboard.dtb"

# Set imx-mkimage boot target
IMXBOOT_TARGETS = "flash_evk flash_evk_no_hdmi flash_dp_evk"
IMX_BOOT_SOC_TARGET = "iMX8M"

SERIAL_CONSOLES = "115200;ttymxc0"

IMAGE_BOOTLOADER = "imx-boot"

LOADADDR = ""
UBOOT_SUFFIX = "bin"
UBOOT_MAKE_TARGET = ""
IMX_BOOT_SEEK = "33"

# If you change TEE_LOAD_ADDR, make sure to align patch for soc.mak
TEE_LOAD_ADDR ?= "0x56000000"
TEE_CFG_DDR_SIZE ?= "0x100000000"
```

## layers/meta-balena-imx8m-var-dart/conf/machine/variscite.inc
```bitbake
## Brough in from Kirkstone branch of meta-variscite-bsp github repository
## See https://variwiki.com/index.php?title=DART-MX8M-MINI_Release_Notes&release=mx8mm-yocto-kirkstone-5.15-2.0.x-v1.3
## for release details
INHERIT += "image-buildinfo"

MACHINE_FEATURES += " pci bluetooth wifi screen"

IMX_DEFAULT_BSP = "nxp"

USE_VT = "0"

KERNEL_IMAGETYPE:mx8-nxp-bsp = "Image.gz"

WKS_FILE:mx8-nxp-bsp = "imx-imx-boot-singlepart.wks.in"

# Set a more generic tuning for code reuse across parts
DEFAULTTUNE:mx8-nxp-bsp:fslc     ?= "armv8a-crc-crypto"
DEFAULTTUNE:mx8m-nxp-bsp:fslc    ?= "armv8a-crc-crypto"
DEFAULTTUNE:mx8qxp-nxp-bsp:fslc  ?= "armv8a-crc-crypto"
DEFAULTTUNE:mx8x-nxp-bsp:fslc    ?= "armv8a-crc-crypto"

# Variscite BSP default providers
PREFERRED_RPROVIDER_u-boot-default-env ?= "u-boot-variscite"

# Use i.MX Gstreamer Version
MACHINE_GSTREAMER_1_0_PLUGIN:mx8-nxp-bsp = "imx-gst1.0-plugin"
PREFERRED_VERSION_imx-gst1.0-plugin:mx8-nxp-bsp ?= "4.7.0"
PREFERRED_VERSION_gstreamer1.0:mx8-nxp-bsp              ?= "1.20.0.imx"
PREFERRED_VERSION_gstreamer1.0-plugins-base:mx8-nxp-bsp ?= "1.20.0.imx"
PREFERRED_VERSION_gstreamer1.0-plugins-good:mx8-nxp-bsp ?= "1.20.0.imx"
PREFERRED_VERSION_gstreamer1.0-plugins-bad:mx8-nxp-bsp  ?= "1.20.0.imx"
PREFERRED_VERSION_gstreamer1.0-plugins-ugly:mx8-nxp-bsp ?= "1.20.0"
PREFERRED_VERSION_gstreamer1.0-libav:mx8-nxp-bsp        ?= "1.20.0"
PREFERRED_VERSION_gstreamer1.0-rtsp-server:mx8-nxp-bsp  ?= "1.20.0"

# Add VPU and Cortex M4/M7 firmware
MACHINE_FIRMWARE:append:mx8-nxp-bsp = " \
	firmware-imx-vpu-imx8 \
	freertos-variscite \
	"

# Add VPU and Cortex M4/M7 firmware
MACHINE_FIRMWARE:append:mx8-nxp-bsp = " \
	freertos-variscite \
	"
MACHINE_EXTRA_RDEPENDS += " \
	gptfdisk \
	hostapd \
	hdparm \
	imx-kobs \
	iw \
	kernel-modules \
	kmod \
	${@bb.utils.contains('DISTRO', 'b2qt', '', \
           bb.utils.contains('DISTRO_FEATURES', 'wayland', 'networkmanager networkmanager-nmcli', \
                                                       '', d), d)} \
	packagegroup-tools-bluetooth \
	bluealsa \
	pm-utils \
	rng-tools \
	wpa-supplicant \
	wireless-regdb-static \
	u-boot-fw-utils \
	u-boot-splash \
"

# Packages added to all images (including core-image-minimal)
IMAGE_INSTALL:append:mx8-nxp-bsp = " \
	kernel-image \
	kernel-devicetree \
"

IMAGE_FSTYPES = "tar.gz wic.gz"

# Wayland based distros add systemd to DISTRO_FEATURES
# Remove sysvinit or systemd based on DISTRO_FEATURES to avoid conflicts
DISTRO_FEATURES_BACKFILL_CONSIDERED:append = "${@bb.utils.contains('DISTRO_FEATURES', 'systemd', ' sysvinit', '', d)}"
DISTRO_FEATURES_BACKFILL_CONSIDERED:append = "${@bb.utils.contains('DISTRO_FEATURES', 'sysvinit', ' systemd', '', d)}"

# Use bluez-alsa instead of pulseaudio
DISTRO_FEATURES_BACKFILL_CONSIDERED:append = " pulseaudio"
```

## layers/meta-balena-imx8m-var-dart/conf/machine/variscite_bcm43xx.inc
```bitbake
## Brough in from Kirkstone branch of meta-variscite-bsp github repository
## See https://variwiki.com/index.php?title=DART-MX8M-MINI_Release_Notes&release=mx8mm-yocto-kirkstone-5.15-2.0.x-v1.3
## for release details

MACHINE_EXTRA_RDEPENDS += " \
	bcm43xx-utils \
	brcm-patchram-plus \
	linux-firmware-bcm4339 \
	linux-firmware-bcm43430 \
"
```

## layers/meta-resin-imx8m-var-dart/conf/layer.conf
```bitbake
BBPATH .= ":${LAYERDIR}"

BBFILES += "${LAYERDIR}/recipes-*/*/*.bb \
            ${LAYERDIR}/recipes-*/*/*.bbappend"

BBFILE_COLLECTIONS += "resin-imx8m-var-dart"
BBFILE_PATTERN_resin-imx8m-var-dart := "^${LAYERDIR}/"
BBFILE_PRIORITY_resin-imx8m-var-dart = "1337"

LAYERSERIES_COMPAT_resin-imx8m-var-dart = "sumo"

# Mask recipes which we do not use
BBMASK .= " .*/meta-fsl-bsp-release/imx/meta-bsp/recipes-browser "
BBMASK .= " .*/meta-freescale/recpes-graphics"
BBMASK .= " .*/meta-variscite-imx/recipes-core/packagegroup"
BBMASK .= " .*/meta-freescale/dynamic-layers"
BBMASK .= " .*/meta-freescale/recipes-multimedia"
BBMASK .= " .*/meta-fsl-bsp-release/imx/meta-bsp/recipes-browser"
BBMASK .= " .*/layers/meta-fsl-bsp-release/imx/meta-bsp/recipes-multimedia/gstreamer/"

IMAGE_INSTALL_remove = "fsl-rc-local"
```
